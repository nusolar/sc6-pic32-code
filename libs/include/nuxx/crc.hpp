/**
 * File:   crc.hpp
 * Author: alex
 *
 * Created on September 8, 2013, 9:20 PM
 *
 * @file This namespace provides CRC computation functions, which are used by
 * the LTC6803 and LTC6804.
 */

#ifndef NUXX_CRC_HPP
#define	NUXX_CRC_HPP

#include "nuxx/errorcodes.hpp"
#include "nu/compiler.h"
#include <cstdint>

namespace nu {
	namespace crc {
		/**
		 * characteristic polynomial: x15 + x14 + x10 + x8 + x7 + x4 + x3 + 1
		 *     so, divisor is: 0b1100010110011001 == 0xc599
		 *     so, the CRC polynom is: 0xc599 - (2^15) == 0x4599
		 * Seed value: 0b000000000010000 (0x10)
		 *
         * @param data
         * @param len
         * @return CRC between 0x0 and 0xFFFF, or a negative error code.
         */
		static uint32_t _15_can(const void *v_data, size_t len) {
			if (unlikely(v_data == NULL))
				return -ENULPTR;

			const uint8_t *data = (uint8_t *)v_data;
			uint16_t crc = 0x10;

			if (len) do {
				// Shift in the next byte, get a new CRC value.
				uint16_t eor;
				unsigned int i = 8;

				crc ^= (uint16_t)((uint16_t)(*data++) << 7);
				do {
					/* This might produce branchless code */
					eor = crc & 0x4000 ? 0x4599 : 0;
					crc = (uint16_t)(crc << 1);
					crc^= eor;
				} while (--i);
			} while (--len);

			return (crc & 0x7fff)<<1;
		}

		/**
		 * CRC table for Fast CRC-8. See function description, below.
		 */
		static const uint8_t _8_ccitt_tab[] =
		   {0x00, 0x07, 0x0E, 0x09, 0x1C, 0x1B, 0x12, 0x15, 0x38, 0x3F, 0x36, 0x31,
			0x24, 0x23, 0x2A, 0x2D, 0x70, 0x77, 0x7E, 0x79, 0x6C, 0x6B, 0x62, 0x65,
			0x48, 0x4F, 0x46, 0x41, 0x54, 0x53, 0x5A, 0x5D, 0xE0, 0xE7, 0xEE, 0xE9,
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			0xFA, 0xFD, 0xF4, 0xF3};

		/**
		 * Based on code found at http://zorc.breitbandkatze.de/crc.html (scroll down on page)
		 *
		 * From LTC6803 data sheet:
		 * characteristic polynomial x^8 + x^2 + x + 1
		 * initial PEC value of 01000001 (0x41)
		 *
		 * Therefore, CRC calculator settings are as follows:
		 * CRC order (1..64)    : 8
		 * CRC polynom (hex)    : 07
		 * Initial value (hex)  : 41 (direct)
		 * Final XOR value (hex): 00
		 * DON'T reverse data bytes
		 * DON'T reverse CRC result before Final XOR
		 */
		static long long _8_ccitt(const void *data, size_t len) {
			if (unlikely(data == NULL))
				return -ENULPTR;

			const BYTE *dataBytes = (const BYTE *)data;

			unsigned long crc = 0x41;

			while (len--)
				crc = (crc << 8) ^ _8_ccitt_tab[ (crc & 0xff) ^ *dataBytes++];
																	   /* 8 here is referring to the polynomial order */
			/* static const unsigned long crcmask = ((((unsigned long)1<<(8-1))-1)<<1)|1; */
			unsigned long crcmask = 0xff;

			crc &= crcmask;

			return crc;
		}
	}
}

#endif	/* NUXX_CRC_HPP */

